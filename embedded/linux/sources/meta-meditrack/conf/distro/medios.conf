## embedded/linux/sources/meta-meditrack/conf/distro/medios.conf
```bitbake
DISTRO = "medios"
DISTRO_NAME = "MediosOS"
DISTRO_VERSION = "1.0.0"
DISTRO_CODENAME = "scarthgap"

MAINTAINER = "Marcin Bober <mbober1@gmail.com>"

DEBUG_FEATURES ?= ""

CUSTOM_DISTRO_FEATURES = " \
  3g \
  acl \
  bluetooth \
  ipv4 \
  ipv6 \
  ld-is-gold \
  pam \
  pni-names \
  seccomp \
  systemd \
  systemd-resolved \
  usrmerge \
  xattr \
"

DISTRO_FEATURES ?= "${DEBUG_FEATURES} ${CUSTOM_DISTRO_FEATURES}"

DISTRO_EXTRA_RDEPENDS += " packagegroup-core-boot"
DISTRO_EXTRA_RRECOMMENDS += " kernel-module-af-packet"


TOOLCHAIN = "clang"

PACKAGE_CLASSES ?= "package_ipk"

INIT_MANAGER = "systemd"
VIRTUAL-RUNTIME_init_manager = "systemd"
VIRTUAL-RUNTIME_initscripts = "systemd-compat-units"
LICENSE_FLAGS_ACCEPTED = "commercial"
```

## embedded/linux/sources/meta-meditrack/conf/layer.conf
```bitbake
# We have a conf and classes directory, add to BBPATH
BBPATH .= ":${LAYERDIR}"

# We have recipes-* directories, add to BBFILES
BBFILES += "${LAYERDIR}/recipes-*/*/*.bb \
            ${LAYERDIR}/recipes-*/*/*.bbappend"

BBFILE_COLLECTIONS += "meta-meditrack"
BBFILE_PATTERN_meta-meditrack = "^${LAYERDIR}/"
BBFILE_PRIORITY_meta-meditrack = "6"

LAYERDEPENDS_meta-meditrack = "core"
LAYERSERIES_COMPAT_meta-meditrack = "scarthgap"
```
